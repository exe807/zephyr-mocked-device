## sample.yaml
```
# This file is provided so that the application can be compiled using Twister,
# the Zephyr testing tool. In this file, multiple combinations can be specified,
# so that you can easily test all of them locally or in CI.
sample:
  description: Example application
  name: example-application
common:
  integration_platforms:
    - native_sim
tests:
  zephyr.test.app:
    timeout: 5
    harness: console
    harness_config:
      type: multi_line
      ordered: false
      regex:
        - "loop..."
    tags:
      - test_app
    platform_allow:
      - native_sim (editado) 
```

## prj.conf
```kconfig
# Copyright (c) 2021 Nordic Semiconductor ASA
# SPDX-License-Identifier: Apache-2.0
#
# This is a Kconfig fragment which can be used to enable debug-related options
# in the application. See the README for more details.

# compiler
CONFIG_DEBUG_OPTIMIZATIONS=y

# logging
CONFIG_LOG=y
CONFIG_APP_LOG_LEVEL_DBG=y

# Copyright (c) 2021 Nordic Semiconductor ASA
# SPDX-License-Identifier: Apache-2.0
#
# This file contains selected Kconfig options for the application.

CONFIG_SENSOR=y
```

## boards/native_sim.overlay
```dts
/*
 * Copyright (c) 2021 Nordic Semiconductor ASA
 * SPDX-License-Identifier: Apache-2.0
 */

/* This devicetree overlay file will be automatically picked by the Zephyr
 * build system when building the sample for the nucleo_f302r8 board. It shows
 * how the example-application can be built on sample boards already provided
 * by Zephyr.
 */

/ {
	example_sensor: example-sensor {
		compatible = "zephyr,example-sensor";
	};



};
```

## src/main.c
```c
/*
 * Copyright (c) 2021 Nordic Semiconductor ASA
 * SPDX-License-Identifier: Apache-2.0
 */
#include <stdio.h>
#include <zephyr/kernel.h>
#include <zephyr/drivers/sensor.h>
#include <zephyr/logging/log.h>

#include <app_version.h>
const struct device *sensor;
void my_timer_handler(struct k_timer *dummy);

LOG_MODULE_REGISTER(main, CONFIG_APP_LOG_LEVEL);

K_TIMER_DEFINE(my_timer, my_timer_handler, NULL);

void my_timer_handler(struct k_timer *dummy)
{
    /* do the processing that needs to be done periodically */
	LOG_INF("work handler...\n");
	int ret;
	struct sensor_value value_x;
	ret = sensor_sample_fetch(sensor);
	if (ret < 0)
	{
		LOG_ERR("End of file, ret= %d\n", ret);
		k_timer_stop(&my_timer);
	}
	else
	{
		ret = sensor_channel_get(sensor, SENSOR_CHAN_AMBIENT_TEMP, &value_x);
		LOG_INF("sensor_sample_get ret: %d  valor del sensor: %d\n", ret, value_x.val1);
	}
}



int main(void)
{
	sensor = DEVICE_DT_GET(DT_NODELABEL(example_sensor));

	if (!device_is_ready(sensor))
	{
		LOG_ERR("Sensor not ready");
		return 0;
	}

	/* start a periodic timer that expires once every second */
	k_timer_start(&my_timer, K_SECONDS(1), K_SECONDS(1));
	LOG_INF("main function, enabling timmer...\n");
	// while (1)
	// {
	// 	/* empty, waiting for the timer to expire and call the handler */
	// 	k_sleep(K_FOREVER); // Put the main thread to sleep
	// }

	return 0;
}
```
