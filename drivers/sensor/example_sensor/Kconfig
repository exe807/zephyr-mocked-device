## drivers/sensor/example_sensor/Kconfig
```kconfig
# Copyright (c) 2021 Nordic Semiconductor ASA
# SPDX-License-Identifier: Apache-2.0

config EXAMPLE_SENSOR
	bool "Example sensor"
	default y
	depends on DT_HAS_ZEPHYR_EXAMPLE_SENSOR_ENABLED
	select GPIO
	help
	  Enable example sensor

config PATH_TO_CSV_FILE
	string "Path to the CSV file"
	default "./data.csv"
	help
	  Configura la ruta al archivo CSV.

config SIZE_LINE_MAX
	int "Max size of a line in the CSV file"
	default 10
	help
	  Configura el tamaño máximo de una línea en el archivo CSV.
```

## dts/bindings/sensor/zephyr,example-sensor.yaml
```yaml
# Copyright (c) 2021 Nordic Semiconductor ASA
# SPDX-License-Identifier: Apache-2.0

description: |
  Add comment mother fucker.

compatible: "zephyr,example-sensor"

include: base.yaml
```
